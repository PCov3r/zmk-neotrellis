## Kconfig
```kconfig
# file: zephyr/Kconfig
menu "NeoTrellis (Adafruit Seesaw) driver"

config ZMK_NEOTRELLIS
    bool "Adafruit NeoTrellis driver"
    default n
    help
      Enable support for the Adafruit NeoTrellis (Seesaw-based 4x4 keypad).

endmenu
```

## dts/bindings/adafruit,trellis.yaml
```yaml
description: Adafruit Seesaw NeoTrellis keypad

compatible: "adafruit,trellis"

include: i2c-device.yaml

properties:
  rows:
    type: int
    required: true
    description: Number of rows (4)
  cols:
    type: int
    required: true
    description: Number of columns (4)
```
